## drivers/amlogic/input/jogball/Kconfig
```kconfig
#
#  jogball input device configuration
#

config JOGBALL_INPUT_GPIO
	tristate "Jogball Input Device Driver Support"
	help
	  Say Y here if you want to support gpio based keys, wheels etc...
	  
```

## drivers/misc/bosch_bma250/Kconfig
```kconfig
#
# Miscellaneous I2C chip drivers configuration
#
# *** DEPRECATED! Do not add new entries! See Makefile ***
#

menu "Miscellaneous I2C Chip support"


config BOSCH_BMA250
	tristate "BMA250 acceleration sensor support"
	depends on I2C=y
	help
	  If you say yes here you get support for Bosch Sensortec's 
	  acceleration sensors BMA250.

config BOSCH_BMA250_ENABLE_INT1
	tristate "BMA250 acceleration sensor interrupt INT1 support"
	depends on BOSCH_BMA250=y
	help
	  If you say yes here you get INT1 support for Bosch Sensortec's 
	  acceleration sensors BMA250.

config BOSCH_BMA250_ENABLE_INT2
	tristate "BMA250 acceleration sensor interrupt INT2 support"
	depends on BOSCH_BMA250=y
	help
	  If you say yes here you get INT2 support for Bosch Sensortec's 
	  acceleration sensors BMA250.


endmenu
```
